/*
 * Copyright (c) 2020 The ZMK Contributors
 *
 * SPDX-License-Identifier: MIT
 */

#include <input/processors.dtsi>                // Provides &zip_xy_transform, &zip_xy_to_scroll_mapper, &zip_scroll_scaler
#include <dt-bindings/zmk/input_transform.h>    // Provides INPUT_TRANSFORM_X_INVERT and INPUT_TRANSFORM_Y_INVERT
#include "glove80.dtsi"

/ {
    /* configure the rotary encoder */
    left_encoder: encoder_left {
        compatible = "alps,ec11";
        a-gpios = <&gpio0 22 (GPIO_ACTIVE_HIGH | GPIO_PULL_UP)>; //Adjust A pin 
        b-gpios = <&gpio0 21 (GPIO_ACTIVE_HIGH | GPIO_PULL_UP)>; //Adjust B pin
        steps = <80>; // Standard EC-11 has 4 pulse per detent, 20 detents for a full rotation
        status = "okay";
    };

    /* Define the rotary encoder sensors */
    sensors: sensor {
        compatible = "zmk,keymap-sensors";
        sensors = <&left_encoder>;
        triggers-per-rotation = <20>; // Standard EC-11 has 20 detents for a full rotation
    };
};

/* main trackball listener since left hand is the central */
&trackball_listener {
    status = "okay";
};
